## conf/layer.conf
```bitbake
# We have a conf and classes directory, add to BBPATH
BBPATH .= ":${LAYERDIR}"

# We have recipes-* directories, add to BBFILES
BBFILES += "${LAYERDIR}/recipes-*/*/*.bb \
            ${LAYERDIR}/recipes-*/*/*.bbappend"

BBFILE_COLLECTIONS += "meta-barcode-demo"
BBFILE_PATTERN_meta-barcode-demo = "^${LAYERDIR}/"
BBFILE_PRIORITY_meta-barcode-demo = "16"

LAYERDEPENDS_meta-barcode-demo = "core rzg2"
LAYERSERIES_COMPAT_meta-barcode-demo = "dunfell"
```

## conf/machine/barcode-poc-g2l.conf
```bitbake
#@TYPE: Machine
#@NAME: barcode-poc-g2l machine
#@DESCRIPTION: RZ/G2L based Barcode PoC

SOC_FAMILY = "r9a07g044l"
require conf/machine/include/rzg2l-common.inc
require conf/machine/include/cip-core.inc

DEFAULTTUNE ?= "cortexa55"

TUNE_CONF ?= "conf/machine/include/tune-cortexa55.inc"
require ${TUNE_CONF}

PREFERRED_PROVIDER_virtual/kernel="linux-renesas"
KERNEL_ALT_IMAGETYPE = "Image.gz"

UBOOT_CONFIG ??= "smarc-rzg2l"
UBOOT_CONFIG[smarc-rzg2l] = "smarc-rzg2l_defconfig"

# Flash writer
EXTRA_IMAGEDEPENDS += "flash-writer"

# Support board with PMIC. Default:yes.
# With this option enabled, build both bin files for PMIC board and Discrete board.
PMIC_SUPPORT ?= "1"

KERNEL_DEVICETREE = " \
	renesas/r9a07g044l2-barcode-poc.dtb \
"

# WiFi support
MACHINE_FEATURES += "wifi"
MACHINE_ESSENTIAL_EXTRA_RDEPENDS += " \
	linux-firmware-bcm4373 \
	ifx-backports \
"

# Bluetooth support
MACHINE_FEATURES += "bluetooth"
MACHINE_ESSENTIAL_EXTRA_RDEPENDS += " \
	linux-firmware-da14531 \
"
```

## wic/sdcard.wks
```
# short-description: Barcode PoC SD card image
# long-description: SD card image for the Barcode PoC. The first partition
# contains the rootfs, the second partition contains data.

part /     --fstype=ext4 --label root --ondisk mmcblk0 --fixed-size 1024 --source rootfs
part /data --fstype=vfat --label data --ondisk mmcblk0 --size       12000 --fsoptions "defaults,noauto"
```
